## config/west.yml
```yaml
manifest:
  remotes:
    - name: zmkfirmware
      url-base: https://github.com/zmkfirmware
  projects:
    - name: zmk
      remote: zmkfirmware
      revision: 4f72e7cb2570777dce7a52fb407752df8a1b611a
      import: app/west.yml
  self:
    path: config
```
